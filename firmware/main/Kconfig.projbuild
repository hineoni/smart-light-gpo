## firmware/main/Kconfig.projbuild
```kconfig
menu "SmartLight Configuration"

    config SMARTLIGHT_DEFAULT_AP_SSID
        string "Default AP SSID"
        default "SmartLight-Setup"
        help
            WiFi SSID when device is in configuration mode

    config SMARTLIGHT_DEFAULT_AP_PASSWORD
        string "Default AP Password"
        default "smartlight"
        help
            WiFi password when device is in configuration mode

    config SMARTLIGHT_SERVO1_PIN
        int "Servo 1 GPIO Pin"
        range 0 39
        default 12
        help
            GPIO pin for first servo motor

    config SMARTLIGHT_SERVO2_PIN
        int "Servo 2 GPIO Pin"
        range 0 39
        default 14
        help
            GPIO pin for second servo motor

    config SMARTLIGHT_HEARTBEAT_INTERVAL
        int "WebSocket Heartbeat Interval (ms)"
        range 5000 60000
        default 15000
        help
            Interval in milliseconds for sending heartbeat messages to backend

endmenu
```

## firmware/sdkconfig.defaults
```kconfig
# ESP-IDF project configuration

# Partition Table
CONFIG_PARTITION_TABLE_CUSTOM=y
CONFIG_PARTITION_TABLE_CUSTOM_FILENAME="partitions.csv"
CONFIG_ESPTOOLPY_FLASHSIZE_4MB=y

# Bluetooth Configuration (Bluedroid Stack)
CONFIG_BT_ENABLED=y
CONFIG_BT_BLUEDROID_ENABLED=y
CONFIG_BT_CLASSIC_ENABLED=y
CONFIG_BT_BLE_ENABLED=y
CONFIG_BT_CONTROLLER_ENABLED=y
CONFIG_BT_BTC_TASK_STACK_SIZE=3072
CONFIG_BT_BLUEDROID_PINNED_TO_CORE_0=y
CONFIG_BT_BTU_TASK_STACK_SIZE=4096
CONFIG_BT_GATTS_ENABLE=y
CONFIG_BT_GATTC_ENABLE=y

# WiFi Configuration
CONFIG_ESP32_WIFI_STATIC_RX_BUFFER_NUM=10
CONFIG_ESP32_WIFI_DYNAMIC_RX_BUFFER_NUM=32
CONFIG_ESP32_WIFI_DYNAMIC_TX_BUFFER_NUM=32
CONFIG_ESP32_WIFI_TX_BUFFER_TYPE=1

# HTTP Server
CONFIG_HTTPD_MAX_REQ_HDR_LEN=1024
CONFIG_HTTPD_MAX_URI_LEN=512

# WebSocket Client
CONFIG_WS_BUFFER_SIZE=1024
CONFIG_ESP_PROTOCOMM_SUPPORT_SECURITY_VERSION_1=y

# NVS Flash
CONFIG_NVS_ENCRYPTION=y

# SPIFFS
CONFIG_SPIFFS_MAX_PARTITIONS=3

# FreeRTOS
CONFIG_FREERTOS_HZ=1000
CONFIG_FREERTOS_USE_TRACE_FACILITY=y
CONFIG_FREERTOS_USE_STATS_FORMATTING_FUNCTIONS=y

# Log levels
CONFIG_LOG_DEFAULT_LEVEL_INFO=y
CONFIG_LOG_MAXIMUM_LEVEL=4
CONFIG_BOOTLOADER_LOG_LEVEL_INFO=y

# SmartLight specific configs
CONFIG_SMARTLIGHT_DEFAULT_AP_SSID="SmartLight-Setup"
CONFIG_SMARTLIGHT_DEFAULT_AP_PASSWORD="smartlight"
CONFIG_SMARTLIGHT_SERVO1_PIN=12
CONFIG_SMARTLIGHT_SERVO2_PIN=14
CONFIG_SMARTLIGHT_HEARTBEAT_INTERVAL=15000
```
